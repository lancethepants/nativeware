## defconfig
```kconfig
BR2_arm=y
BR2_cortex_a9=y
BR2_DL_DIR="$(BASE)/dl/"
BR2_HOST_DIR="/opt/brcm"
BR2_JLEVEL=JOBS
BR2_KERNEL_HEADERS_VERSION=y
BR2_DEFAULT_KERNEL_VERSION="2.6.36.4"
BR2_TOOLCHAIN_BUILDROOT_LARGEFILE=y
BR2_TOOLCHAIN_BUILDROOT_INET_IPV6=y
BR2_TOOLCHAIN_BUILDROOT_INET_RPC=y
BR2_TOOLCHAIN_BUILDROOT_LOCALE=y
BR2_TOOLCHAIN_BUILDROOT_CXX=y
BR2_TOOLCHAIN_BUILDROOT_USE_SSP=y
# BR2_PACKAGE_BUSYBOX is not set
BR2_PACKAGE_MPC=y
# BR2_TARGET_ROOTFS_TAR is not set
```
